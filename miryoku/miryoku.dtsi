// Copyright 2022 Manna Harbour
// https://github.com/manna-harbour/miryoku

#include <behaviors.dtsi>
#include <dt-bindings/zmk/keys.h>
#include <dt-bindings/zmk/bt.h>
#include <dt-bindings/zmk/rgb.h>
#include <dt-bindings/zmk/outputs.h>
#include <dt-bindings/zmk/ext_power.h>

#include "miryoku.h"

/ {
  keymap {
    compatible = "zmk,keymap";
#define MIRYOKU_X(LAYER, STRING) \
    U_##LAYER## { \
      label = STRING; \
      bindings = < U_MACRO_VA_ARGS(MIRYOKU_LAYERMAPPING_##LAYER, MIRYOKU_LAYER_##LAYER) >; \
    };
MIRYOKU_LAYER_LIST
#undef MIRYOKU_X
  };
};

#include "miryoku_shift_functions.dtsi"

#include "miryoku_double_tap_guard.dtsi"

#if defined (MIRYOKU_KLUDGE_MOUSEKEYSPR)
  #include "miryoku_kludge_mousekeyspr.dtsi"
#else
  #include "miryoku_mousekeys.dtsi"
#endif

#if defined (MIRYOKU_KLUDGE_THUMBCOMBOS)
  #include "miryoku_kludge_thumbcombos.dtsi"
#endif

#if defined (MIRYOKU_KLUDGE_TOPROWCOMBOS)
  #include "miryoku_kludge_toprowcombos.dtsi"
#endif

#if defined (MIRYOKU_KLUDGE_BOTTOMROWCOMBOS)
  #include "miryoku_kludge_bottomrowcombos.dtsi"
#endif

#if defined (MIRYOKU_KLUDGE_TAPDELAY)
  #include "miryoku_kludge_tapdelay.dtsi"
#else
  #include "miryoku_behaviors.dtsi"
#endif

// My configs

    
&key_repeat {
    usage-pages = <HID_USAGE_KEY HID_USAGE_CONSUMER>;
};

/ {
    behaviors {
  u_mt: u_mt {
      compatible = "zmk,behavior-hold-tap";
      label = "u_mt";
      #binding-cells = <2>;
      tapping_term_ms = <U_TAPPING_TERM>;
      flavor = "tap-preferred";
      bindings = <&sk>, <&kp>;
    };
  u_lt: u_lt {
      compatible = "zmk,behavior-hold-tap";
      label = "u_lt";
      #binding-cells = <2>;
      tapping_term_ms = <U_TAPPING_TERM>;
      flavor = "tap-preferred";
      bindings = <&sl>, <&kp>;
    };
  u_lt_shift: u_lt_shift {
      compatible = "zmk,behavior-hold-tap";
      label = "u_lt_shift";
      #binding-cells = <2>;
      tapping_term_ms = <U_TAPPING_TERM>;
      flavor = "tap-preferred";
      bindings = <&sl>, <&sk>;
    };
  u_lt_to: u_lt_to {
      compatible = "zmk,behavior-hold-tap";
      label = "u_lt_to";
      #binding-cells = <2>;
      tapping_term_ms = <U_TAPPING_TERM>;
      flavor = "tap-preferred";
      bindings = <&to>, <&kp>;
    };
  // u_td_shift: u_td_shift {
  //           compatible = "zmk,behavior-tap-dance";
  //           label = "u_td_shift";
  //           #binding-cells = <0>;
  //           tapping-term-ms = <200>;
  //           bindings = <&lt U_NUM LSHIFT>, <&kp CAPSLOCK>;
  //       };
//   u_lt_td_shift: u_lt_td_shift {
//       compatible = "zmk,behavior-hold-tap";
//       label = "u_lt_td_shift";
//       #binding-cells = <2>;
//       tapping_term_ms = <U_TAPPING_TERM>;
//       flavor = "tap-preferred";
//       bindings = <&sl U_NUM>, <&u_td_shift>;
//     };
  };
};

// / {
//   combos {
//     compatible = "zmk,combos";
//         MIRYOKU_KLUDGE_THUMBCOMBOS_MACRO(U_BASE, RIGHT, &lt U_SYM DEL)
//         MIRYOKU_KLUDGE_THUMBCOMBOS_MACRO(U_SYM, LEFT, &kp RPAR)
//   };
// };

/ {
    macros {
        // mouse_speed_1: mouse_speed_1 {
        //     label = "ZM_mouse_speed_1";
        //     compatible = "zmk,behavior-macro";
        //     #binding-cells = <0>;
        //     bindings
        //         = <&macro_press &kp LGUI &kp LALT &kp LCTRL>
        //         , <&macro_tap &kp N>
        //         , <&macro_release &kp LGUI &kp LALT &kp LCTRL>
        //         ;
        // };
        mouse_speed_1: mouse_speed_1 {
            label = "ZM_mouse_speed_1";
            compatible = "zmk,behavior-macro";
            #binding-cells = <0>;
            bindings
                = <&macro_press &kp LGUI &kp LALT &kp LCTRL>
                , <&macro_tap &kp N>
                , <&macro_release &kp LGUI &kp LALT &kp LCTRL>
                , <&macro_pause_for_release>
                , <&macro_press &kp LGUI &kp LALT &kp LCTRL>
                , <&macro_tap &sk U>
                , <&macro_release &kp LGUI &kp LALT &kp LCTRL>
                ;
        };
        mouse_speed_2: mouse_speed_2 {
            label = "ZM_mouse_speed_2";
            compatible = "zmk,behavior-macro";
            #binding-cells = <0>;
            bindings
                = <&macro_press &kp LGUI &kp LALT &kp LCTRL>
                , <&macro_tap &kp E>
                , <&macro_release &kp LGUI &kp LALT &kp LCTRL>
                , <&macro_pause_for_release>
                , <&macro_press &kp LGUI &kp LALT &kp LCTRL>
                , <&macro_tap &sk U>
                , <&macro_release &kp LGUI &kp LALT &kp LCTRL>
                ;
        };
        mouse_speed_3: mouse_speed_3 {
            label = "ZM_mouse_speed_3";
            compatible = "zmk,behavior-macro";
            #binding-cells = <0>;
            bindings
                = <&macro_press &kp LGUI &kp LALT &kp LCTRL>
                , <&macro_tap &kp I>
                , <&macro_release &kp LGUI &kp LALT &kp LCTRL>
                , <&macro_pause_for_release>
                , <&macro_press &kp LGUI &kp LALT &kp LCTRL>
                , <&macro_tap &sk U>
                , <&macro_release &kp LGUI &kp LALT &kp LCTRL>
                ;
        };
        mouse_speed_4: mouse_speed_4 {
            label = "ZM_mouse_speed_4";
            compatible = "zmk,behavior-macro";
            #binding-cells = <0>;
            bindings
                = <&macro_press &kp LGUI &kp LALT &kp LCTRL>
                , <&macro_tap &kp O>
                , <&macro_release &kp LGUI &kp LALT &kp LCTRL>
                , <&macro_pause_for_release>
                , <&macro_press &kp LGUI &kp LALT &kp LCTRL>
                , <&macro_tap &sk U>
                , <&macro_release &kp LGUI &kp LALT &kp LCTRL>
                ;
        };
        
  // u_mt_mouse: u_mt_mouse {
  //     compatible = "zmk,behavior-hold-tap";
  //     label = "u_mt_mouse";
  //     #binding-cells = <2>;
  //     tapping_term_ms = <U_TAPPING_TERM>;
  //     flavor = "tap-preferred";
  //     bindings = <&sk>, <&kp>;
  //   };
    };
};

